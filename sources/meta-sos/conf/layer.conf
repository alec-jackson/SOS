## sources/meta-sos/conf/layer.conf
```bitbake
# We have a conf and classes directory, add to BBPATH
BBPATH =. "${LAYERDIR}:"

# We have recipes-* directories, add to BBFILES
BBFILES += "${LAYERDIR}/recipes-*/*/*.bb \
            ${LAYERDIR}/recipes-*/*/*.bbappend"

BBFILE_COLLECTIONS += "studious-os"
BBFILE_PATTERN_studious-os = "^${LAYERDIR}/"
BBFILE_PRIORITY_studious-os = "7"

LAYERSERIES_COMPAT_studious-os = "walnascar"

# This should only be incremented on significant changes that will
# cause compatibility issues with other layers
LAYERVERSION_studious-os = "1"

LAYERDEPENDS_studious-os = "core"

REQUIRED_POKY_BBLAYERS_CONF_VERSION = "1"
```
